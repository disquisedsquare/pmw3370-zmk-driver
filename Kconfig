## Kconfig
```kconfig
config PMW3370
	bool "Enable PMW3370 optical sensor driver"
	depends on SPI && INPUT
	help
	  Enable support for the PixArt PMW3370 optical sensor for trackballs/pointing devices.

if PMW3370

config PMW3370_CPI
	int "Default CPI for PMW3370"
	default 1600
	range 100 19000
	help
	  Default counts per inch (CPI) resolution for the sensor.

endif
```

## drivers/sensor/Kconfig
```kconfig
menuconfig PMW3370
    bool "Enable PMW3370 sensor support"
    help
      Enables a PixArt PMW3370 driver for Zephyr/ZMK.

config PMW3370_POLL_MS
    int "Polling interval (ms) when IRQ isn't used"
    default 4
    help
      Fallback polling interval.
```

## dts/bindings/pixart,pmw3370.yaml
```yaml
# Device tree binding for PixArt PMW3370 (PMW33xx family)
title: "PixArt PMW3370 optical sensor"
description: |
  Device tree binding for PixArt PMW3370 optical sensors used as
  a trackball / mouse sensor on Zephyr/ZMK.
properties:
  compatible:
    const: pixart,pmw3370
  reg:
    description: SPI reg (chip select index)
    type: array
    items:
      - type: integer
  spi-max-frequency:
    type: integer
  cs-gpios:
    description: Chip select GPIO (controller, pin, flags)
    type: array
    items:
      - $ref: /schemas/gpio.yaml
  irq-gpios:
    description: Motion/IRQ pin from sensor (controller, pin, flags)
    type: array
    items:
      - $ref: /schemas/gpio.yaml
  cpi:
    type: integer
  evt-type:
    description: input event type (e.g. INPUT_EV_REL)
    type: integer
  x-input-code:
    type: integer
  y-input-code:
    type: integer
required:
  - compatible
  - reg
  - spi-max-frequency
  - cs-gpios
  - irq-gpios
  - evt-type
  - x-input-code
  - y-input-code
```

## dts/bindings/sensor/pixart,pmw3370.yaml
```yaml
compatible: "pixart,pmw3370"

description: PixArt PMW3370 optical mouse sensor

include: spi-device.yaml

properties:
  irq-gpios:
    type: phandle-array
    required: true
    description: Motion interrupt GPIO pin

  scroll-layers:
    type: int-array
    required: false
    description: Layers where motion is interpreted as scrolling

  snipe-layers:
    type: int-array
    required: false
    description: Layers where precision (snipe) mode is enabled

  automouse-layer:
    type: int
    required: false
    description: Layer to auto-activate on motion
```
